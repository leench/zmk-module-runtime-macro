## Kconfig
```kconfig
# Copyright (c) 2026 The ZMK Contributors
# SPDX-License-Identifier: MIT

config ZMK_BEHAVIOR_RUNTIME_MACRO
    bool "Runtime Macro behavior"
    default y
    depends on DT_HAS_ZMK_BEHAVIOR_RUNTIME_MACRO_ENABLED
    depends on SETTINGS
    help
      Enable the runtime_macro behavior that triggers the US ASCII text stored
      in one of the fixed macro slots (&runtime_macro <slot>).

if ZMK_BEHAVIOR_RUNTIME_MACRO

config ZMK_RUNTIME_MACRO_TAP_MS
    int "Runtime macro tap time (milliseconds)"
    default ZMK_MACRO_DEFAULT_TAP_MS
    range 0 1000
    help
      Time each character remains pressed while a runtime macro is emitted.
      The default follows ZMK's global macro tap time.

config ZMK_RUNTIME_MACRO_WAIT_MS
    int "Runtime macro wait time (milliseconds)"
    default ZMK_MACRO_DEFAULT_WAIT_MS
    range 0 1000
    help
      Delay between releasing one character and pressing the next character
      while a runtime macro is emitted. The default follows ZMK's global macro
      wait time.

config ZMK_RUNTIME_MACRO_SLOT_COUNT
    int "Number of macro slots"
    default 8
    range 1 16
    help
      Fixed number of macro slots addressed by &runtime_macro <slot> bindings.
      Slot indexes outside of 0..(count - 1) are rejected.

config ZMK_RUNTIME_MACRO_MAX_TEXT_LEN
    int "Maximum text length per macro slot (characters)"
    default 64
    range 1 256
    help
      Maximum number of US ASCII characters a single macro slot can hold.
      The module allocates one NUL-terminated RAM buffer of this size per slot
      and uses the same limit for Settings/NVS persistence and execution.

config ZMK_RUNTIME_MACRO_USB_HID
    bool "Runtime Macro USB HID transport"
    default n
    depends on ZMK_USB
    depends on USB_DEVICE_STACK
    depends on (!ZMK_SPLIT || ZMK_SPLIT_ROLE_CENTRAL)
    help
      Expose the runtime macro protocol through a dedicated legacy USB HID
      interface. The transport is central-side only and keeps the ZMK keyboard
      HID_0 interface unchanged. The module requires a 32-byte interrupt
      endpoint; the build fails if an explicit board configuration does not
      provide that value. Do not enable CONFIG_ENABLE_HID_INT_OUT_EP because
      that option applies to every HID instance, including ZMK's keyboard
      HID_0.

config ZMK_RUNTIME_MACRO_USB_HID_DEVICE
    string "Runtime Macro USB HID device"
    default "HID_1"
    help
      Zephyr USB HID device name used by the runtime macro transport. HID_1
      is the default. If another module already owns HID_1, increase
      USB_HID_DEVICE_COUNT and assign this transport to a different unused
      instance, such as HID_2.

endif # ZMK_BEHAVIOR_RUNTIME_MACRO

# The legacy HID class owns these global settings for all HID instances. Add
# safe defaults when the optional transport is enabled; the transport source
# also rejects explicit incompatible values at build time.
config USB_HID_DEVICE_COUNT
    default 2 if ZMK_RUNTIME_MACRO_USB_HID

config HID_INTERRUPT_EP_MPS
    default 32 if ZMK_RUNTIME_MACRO_USB_HID
```

## dts/bindings/behaviors/zmk,behavior-runtime-macro-dynamic.yaml
```yaml
# Copyright (c) 2026 The ZMK Contributors
# SPDX-License-Identifier: MIT

description: Runtime Macro Dynamic Behavior

compatible: "zmk,behavior-runtime-macro-dynamic"

include: zero_param.yaml
```

## dts/bindings/behaviors/zmk,behavior-runtime-macro.yaml
```yaml
# Copyright (c) 2026 The ZMK Contributors
# SPDX-License-Identifier: MIT

description: Runtime Macro Behavior

compatible: "zmk,behavior-runtime-macro"

include: one_param.yaml
```
