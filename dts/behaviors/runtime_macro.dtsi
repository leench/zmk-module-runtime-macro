/*
 * Copyright (c) 2026 The ZMK Contributors
 *
 * SPDX-License-Identifier: MIT
 */

#include <dt-bindings/zmk/behaviors.h>

/*
 * Keep-all snippets retain every behavior node, which would otherwise make
 * the dynamic feature look referenced in static-only keymaps.  Preserve the
 * normal omit-if-no-ref behavior unless a keymap explicitly asks to keep the
 * dynamic node for another reason.
 */
#if !defined(ZMK_BEHAVIORS_KEEP_RMD) && !defined(ZMK_BEHAVIORS_OMIT_RMD)
#define ZMK_BEHAVIORS_OMIT_RMD
#endif

/ {
    behaviors {
#if ZMK_BEHAVIOR_OMIT(RM)
        /omit-if-no-ref/
#endif
        runtime_macro: runtime_macro {
            compatible = "zmk,behavior-runtime-macro";
            #binding-cells = <1>;
            display-name = "Runtime Macro";
        };
#if ZMK_BEHAVIOR_OMIT(RMD)
        /omit-if-no-ref/
#endif
        runtime_macro_dynamic: runtime_macro_dynamic {
            compatible = "zmk,behavior-runtime-macro-dynamic";
            #binding-cells = <1>;
            display-name = "Runtime Macro Dynamic";
        };
    };
};
